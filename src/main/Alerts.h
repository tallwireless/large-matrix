#pragma once

const uint16_t WASHER_RUNNING[] = {21,21,20512,20512,20512,0,0,0,0,0,0,0,0,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20512,20512};

const uint16_t WASHER_COMPLETED[] = {21,21,6248,6248,6248,0,0,0,0,0,0,0,0,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6248,6248};

const uint16_t DRYER_RUNNING[] = {21,21,0,0,20545,20545,20545,20545,20545,20545,20545,20545,20545,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0,0};

const uint16_t DRYER_COMPLETED[] = {21,21,0,0,2122,2122,2122,2122,2122,2122,2122,2122,2122,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0,0};

#include "Widget.h"
#include <MQTTPubSubClient_Generic.h>
#include <ArduinoJson.h>
#include "helper.h"

#define NUM_DEVICES 2

#define WASHER 0
#define DRYER 1

#define FREE 0
#define RUNNING 1
#define COMPLETED 2

class Alerts : public Widget {

  public:
    Alerts(MQTTPubSubClient *client) : Widget() {
        this->mqttClient = client;
        this->state[0] = FREE;
        this->state[1] = FREE;
    };
    void handleMQTTUpdate(const String &payload, const size_t size) {
        StaticJsonDocument<200> doc;
        DeserializationError error = deserializeJson(doc, payload);
        if (error) {
            Serial.print(F("deserializeJson() failed: "));
            Serial.println(error.f_str());
            return;
        }
        if ((int)doc["device"] > NUM_DEVICES ) {
            return;
        }
        this->state[(int)doc["device"]] = (int)doc["state"];
        Serial.print("MQTT Message Recieved: ");
        Serial.println(payload);

    };
    bool updateWidget(void) {
        // Check to see the washer state
        if (state[WASHER] == RUNNING ) {
            drawIcon(x+11,y,WASHER_RUNNING,canvas);
        } else if(state[WASHER] == COMPLETED ) {
            drawIcon(x+11,y,WASHER_COMPLETED,canvas);
        } else {
            canvas->writeFillRect(x+11,y,21,21,0);
        }
        // Need to draw the icon!
        if (state[DRYER] == RUNNING ) {
            drawIcon(x+11+21,y,DRYER_RUNNING,canvas);
        } else if (state[DRYER] == COMPLETED ) {
            drawIcon(x+11+21,y,DRYER_COMPLETED,canvas);
        } else {
            canvas->writeFillRect(x+11+21,y,21,21,0);
        }
        return true;
    };


  private:
    uint8_t state[NUM_DEVICES];
    MQTTPubSubClient* mqttClient;
};
